## esp-idf/main/Kconfig.projbuild
```kconfig
menu "T-Dongle DOOM hardware modes"

config TD_USB_HOST
    bool "Enable native USB host keyboard controls"
    default n
    help
        Switch GPIO19/GPIO20 to USB-OTG host mode and accept boot-protocol
        keyboards. This disconnects USB Serial/JTAG at runtime. Use only with
        a current-limited externally powered host adapter; the T-Dongle-S3
        cannot safely source keyboard VBUS by itself.

config TD_AUDIO_PDM
    bool "Enable eight-channel PDM sound-effects output"
    depends on !TD_USB_HOST
    default n
    help
        Mix the ADPCM sound effects already stored in the WHD image and send
        22.05 kHz mono audio through the ESP32-S3 PCM-to-PDM converter. GPIO43
        is PDM clock and GPIO44 is PDM data on the Qwiic connector. The data
        signal requires an external low-pass filter and audio amplifier.

config TD_WEB_AUDIO
    bool "Enable synchronized browser sound and music events"
    depends on !TD_AUDIO_PDM
    default y
    help
        Preserve DOOM's native eight-channel sound semantics and music state,
        but send compact events to the Wi-Fi control deck for Web Audio
        playback. The renderer never streams or mixes PCM on the ESP32.

endmenu
```

## esp-idf/sdkconfig.defaults
```kconfig
CONFIG_IDF_TARGET="esp32s3"
CONFIG_ESPTOOLPY_FLASHSIZE_16MB=y
CONFIG_ESPTOOLPY_FLASHMODE_QIO=y
CONFIG_ESPTOOLPY_FLASHFREQ_80M=y
CONFIG_PARTITION_TABLE_CUSTOM=y
CONFIG_PARTITION_TABLE_CUSTOM_FILENAME="partitions.csv"
CONFIG_ESP_DEFAULT_CPU_FREQ_MHZ_240=y
CONFIG_FREERTOS_HZ=1000
CONFIG_ESP_CONSOLE_USB_SERIAL_JTAG=y
CONFIG_HTTPD_WS_SUPPORT=y
CONFIG_ESP_WIFI_STATIC_RX_BUFFER_NUM=4
CONFIG_ESP_WIFI_DYNAMIC_RX_BUFFER_NUM=8
CONFIG_ESP_WIFI_DYNAMIC_TX_BUFFER_NUM=8
CONFIG_ESP_WIFI_RX_MGMT_BUF_NUM_DEF=2
CONFIG_ESP_WIFI_MGMT_SBUF_NUM=6
CONFIG_ESP_WIFI_AMPDU_TX_ENABLED=n
CONFIG_ESP_WIFI_AMPDU_RX_ENABLED=n
CONFIG_ESP_WIFI_IRAM_OPT=n
CONFIG_ESP_WIFI_RX_IRAM_OPT=n
CONFIG_ESP_WIFI_ENABLE_WPA3_SAE=n
CONFIG_ESP_WIFI_ENABLE_SAE_PK=n
CONFIG_ESP_WIFI_SOFTAP_SAE_SUPPORT=n
CONFIG_ESP_WIFI_ENABLE_WPA3_OWE_STA=n
CONFIG_ESP_WIFI_ENTERPRISE_SUPPORT=n
CONFIG_LWIP_ND6=n
CONFIG_LWIP_IPV6=n
CONFIG_LWIP_MAX_SOCKETS=8
CONFIG_LWIP_TCPIP_RECVMBOX_SIZE=8
CONFIG_LWIP_DHCPS_MAX_STATION_NUM=1
CONFIG_LWIP_MAX_ACTIVE_TCP=4
CONFIG_LWIP_MAX_LISTENING_TCP=2
CONFIG_LWIP_TCP_SND_BUF_DEFAULT=2880
CONFIG_LWIP_TCP_WND_DEFAULT=2880
CONFIG_LWIP_TCP_QUEUE_OOSEQ=n
CONFIG_LWIP_TCP_OVERSIZE_QUARTER_MSS=y
CONFIG_LWIP_MAX_UDP_PCBS=4
CONFIG_ESP_CONSOLE_SECONDARY_NONE=y
CONFIG_ESP_SYSTEM_PANIC_PRINT_REBOOT=y
CONFIG_COMPILER_OPTIMIZATION_PERF=y
CONFIG_ESP_MAIN_TASK_STACK_SIZE=8192
CONFIG_ESP_MAIN_TASK_AFFINITY_CPU0=y
CONFIG_LOG_DEFAULT_LEVEL_INFO=y
CONFIG_ESP32S3_DATA_CACHE_32KB=y
CONFIG_ESP32S3_INSTRUCTION_CACHE_32KB=y
```
